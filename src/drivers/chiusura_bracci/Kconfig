## src/drivers/chiusura_bracci/Kconfig
```kconfig
config DRIVERS_CHIUSURA_BRACCI
	bool "chiusura_bracci"
	default n
	---help---
	  Simple I2C interface to an ESP32 Nano that reports two analog hall states.
	  I2C address: 0x42
```

## src/modules/camera_input_rc/Kconfig
```kconfig
menuconfig MODULES_CAMERA_INPUT_RC
    bool "camera_input_rc"
    default n
    ---help---
        Enable support for Camera Input RC

menuconfig USER_CAMERA_INPUT_RC
    bool "camera_input_rc running as userspace module"
    default y
    depends on BOARD_PROTECTED && MODULES_CAMERA_INPUT_RC
    ---help---
        Put camera_input_rc in userspace memory
```
